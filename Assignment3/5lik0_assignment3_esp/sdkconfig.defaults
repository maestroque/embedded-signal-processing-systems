## Assignment3/5lik0_assignment3_esp/sdkconfig.defaults
```kconfig
# Set some project configurations. You can find the full list here:
# https://docs.espressif.com/projects/esp-idf/en/v4.4.4/esp32/api-reference/kconfig.html

# Set compiler optimization level
CONFIG_COMPILER_OPTIMIZATION_DEFAULT=y
# CONFIG_COMPILER_OPTIMIZATION_SIZE=y
# CONFIG_COMPILER_OPTIMIZATION_PERF=y
# CONFIG_COMPILER_OPTIMIZATION_NONE=y


# Choose CPU frequency to change it uncoment the desired line and change the value
# CONFIG_ESP32_DEFAULT_CPU_FREQ_40=y
# CONFIG_ESP32_DEFAULT_CPU_FREQ_80=y
CONFIG_ESP32_DEFAULT_CPU_FREQ_160=y
# CONFIG_ESP32_DEFAULT_CPU_FREQ_240=y
CONFIG_ESP32_DEFAULT_CPU_FREQ_MHZ=160

# Enable GDB stub on panic. If you change it to runtime you can only use a single core.
CONFIG_ESP_SYSTEM_PANIC_GDBSTUB=y
# CONFIG_ESP_SYSTEM_GDBSTUB_RUNTIME=y


# -------- DO NOT CHANGE ANYTHING BELOW THIS LINE --------

# Bootloader config
CONFIG_BOOTLOADER_OFFSET_IN_FLASH=0x1000
CONFIG_BOOTLOADER_COMPILER_OPTIMIZATION_SIZE=y

# Serial flasher config
CONFIG_ESPTOOLPY_FLASHSIZE_DETECT=y
CONFIG_ESPTOOLPY_BEFORE_RESET=y

# Partition Table: increase default app partition size to accommodate BT
CONFIG_PARTITION_TABLE_SINGLE_APP=y
CONFIG_PARTITION_TABLE_OFFSET=0x8000
CONFIG_PARTITION_TABLE_MD5=y
CONFIG_PARTITION_TABLE_CUSTOM=y
CONFIG_PARTITION_TABLE_CUSTOM_FILENAME="partitions_bt.csv"
CONFIG_PARTITION_TABLE_FILENAME="partitions_bt.csv"

# CONFIG_ESPTOOLPY_FLASHFREQ_80M=y
# CONFIG_ESPTOOLPY_FLASHMODE_QIO=y
CONFIG_ESPTOOLPY_MONITOR_BAUD_921600B=y

# Enable BT and BT classic
CONFIG_BT_ENABLED=y
CONFIG_BT_CLASSIC_ENABLED=y
CONFIG_BT_A2DP_ENABLE=y
CONFIG_BT_BLUEDROID_ENABLED=y
CONFIG_BTDM_CTRL_MODE_BTDM=y
CONFIG_BTDM_CTRL_BLE_MAX_CONN=1
CONFIG_BTDM_CTRL_BR_EDR_MAX_ACL_CONN=1

# Disable unneeded features to save size
CONFIG_VFS_SUPPORT_IO=n
CONFIG_ESP_WIFI_SOFTAP_SUPPORT=n
CONFIG_LWIP_IPV6=n

# Move parts to flash
CONFIG_ESP32_WIFI_IRAM_OPT=n
CONFIG_ESP32_WIFI_RX_IRAM_OPT=n
```

## Assignment3/5lik0_assignment3_esp/sdkconfig.defaults.esp32
```kconfig
CONFIG_ESP32_REV_MIN_3=y

#
# SDK tool configuration
#
CONFIG_SDK_TOOLPREFIX="xtensa-esp32-elf-"
# CONFIG_SDK_TOOLCHAIN_SUPPORTS_TIME_WIDE_64_BITS is not set
# end of SDK tool configuration

#
# Audio HAL
#
CONFIG_ESP_LYRAT_V4_3_BOARD=y
```
